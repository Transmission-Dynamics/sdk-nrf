## dts/bindings/serial/nordic,nrf-sw-lpuart.yaml
```yaml
# Copyright (c) 2020 Nordic Semiconductor ASA
# SPDX-License-Identifier: LicenseRef-Nordic-5-Clause

description: |
    Low power UART

compatible: "nordic,nrf-sw-lpuart"

include: uart-device.yaml

properties:
  req-pin:
    type: int
    description: Request pin
    required: true

  rdy-pin:
    type: int
    description: Ready pin
    required: true

  auto-init:
    type: boolean
    description: |
      If true, the driver will automatically initialize the peripheral.
      If false, the application must call the `nrf_sw_lpuart_init()` function
      to initialize the peripheral.
```
